#include "ssd1306.h"
#include "i2c.h"
#include <stdio.h>
#include <string.h>
#include "main.h"
#define SSD1306_I2C_ADDR  0x78
/* 6x8 字库（ASCII 32-127） */
static const uint8_t font6x8[][6] = {
    {0x00,0x00,0x00,0x00,0x00,0x00}, // space
    {0x00,0x00,0x5F,0x00,0x00,0x00}, // !
    {0x00,0x07,0x00,0x07,0x00,0x00}, // "
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    {0x08,0x1C,0x2A,0x08,0x08,0x00}, // <-
};

/* 发送一个命令字节 */
static void SSD1306_WriteCmd(uint8_t cmd)
{
    uint8_t buf[2] = {0x00, cmd}; // 0x00 表示命令
    HAL_I2C_Master_Transmit(&hi2c1, SSD1306_I2C_ADDR, buf, 2, 100);
}

/* 发送数据 */
static void SSD1306_WriteData(uint8_t data)
{
    uint8_t buf[2] = {0x40, data}; // 0x40 表示数据
    HAL_I2C_Master_Transmit(&hi2c1, SSD1306_I2C_ADDR, buf, 2, 100);
}

/* 初始化 OLED */
void SSD1306_Init(void)
{
    HAL_Delay(100); // 等待上电稳定

    SSD1306_WriteCmd(0xAE); // 关闭显示
    SSD1306_WriteCmd(0x20); // 设置内存寻址模式
    SSD1306_WriteCmd(0x10); // 页寻址模式
    SSD1306_WriteCmd(0xB0); // 页起始地址 0
    SSD1306_WriteCmd(0xC8); // 扫描方向从下到上
    SSD1306_WriteCmd(0x00); // 低列地址
    SSD1306_WriteCmd(0x10); // 高列地址
    SSD1306_WriteCmd(0x40); // 显示起始行
    SSD1306_WriteCmd(0x81); // 对比度
    SSD1306_WriteCmd(0xFF);
    SSD1306_WriteCmd(0xA1); // 段重映射
    SSD1306_WriteCmd(0xA6); // 正常显示
    SSD1306_WriteCmd(0xA8); // 多路复用率
    SSD1306_WriteCmd(0x3F);
    SSD1306_WriteCmd(0xA4); // 输出跟随 RAM 内容
    SSD1306_WriteCmd(0xD3); // 显示偏移
    SSD1306_WriteCmd(0x00);
    SSD1306_WriteCmd(0xD5); // 显示时钟分频
    SSD1306_WriteCmd(0x80);
    SSD1306_WriteCmd(0xD9); // 预充电周期
    SSD1306_WriteCmd(0xF1);
    SSD1306_WriteCmd(0xDA); // COM 引脚配置
    SSD1306_WriteCmd(0x12);
    SSD1306_WriteCmd(0xDB); // VCOMH
    SSD1306_WriteCmd(0x40);
    SSD1306_WriteCmd(0x8D); // 电荷泵
    SSD1306_WriteCmd(0x14);
    SSD1306_WriteCmd(0xAF); // 打开显示

    SSD1306_Clear();
}

/* 清屏 */
void SSD1306_Clear(void)
{
    uint8_t page, col;
    for (page = 0; page < 8; page++) {
        SSD1306_WriteCmd(0xB0 + page);
        SSD1306_WriteCmd(0x00);
        SSD1306_WriteCmd(0x10);
        for (col = 0; col < 128; col++) {
            SSD1306_WriteData(0x00);
        }
    }
}

/* 显示字符串
   x: 列地址 (0-127)，实际像素
   y: 页地址 (0-7)，对应行
   size: 字体大小，仅支持 1 (6x8) */
void SSD1306_ShowString(uint8_t x, uint8_t y, const char *str, uint8_t size)
{
    if (size != 1) size = 1; // 强制使用 6x8

    SSD1306_WriteCmd(0xB0 + y);   // 设置页地址
    SSD1306_WriteCmd(0x00);       // 设置低列地址
    SSD1306_WriteCmd(0x10);       // 设置高列地址

    while (*str) {
        if (x > 127) break; // 防止超出屏幕
        SSD1306_WriteCmd(0x00 + (x & 0x0F));      // 低列
        SSD1306_WriteCmd(0x10 + (x >> 4));        // 高列
        uint8_t c = *str;
        if (c < 32 || c > 127) c = 32; // 超出范围用空格
        for (uint8_t i = 0; i < 6; i++) {
            SSD1306_WriteData(font6x8[c - 32][i]);
        }
        x += 6; // 下一个字符列位置
        str++;
    }
}

/* 显示整数，len 为最小显示宽度（不足补空格） */
void SSD1306_ShowNumber(uint8_t x, uint8_t y, int num, uint8_t len, uint8_t size)
{
    char str[16];
    snprintf(str, sizeof(str), "%*d", len, num);
    SSD1306_ShowString(x, y, str, size);
}

/* 显示浮点数，保留一位小数 */
void SSD1306_ShowFloat(uint8_t x, uint8_t y, float num, uint8_t len, uint8_t size)
{
    char str[16];
    snprintf(str, sizeof(str), "%*.*f", len, 1, num);
    SSD1306_ShowString(x, y, str, size);
}
/* 检查 OLED 是否正常，若不正常则重新初始化 */
void SSD1306_CheckAndRecover(void)
{
    // 检查 I2C 设备是否就绪，超时 5ms，重试 100 次
    if (HAL_I2C_IsDeviceReady(&hi2c1, SSD1306_I2C_ADDR, 5, 100) != HAL_OK) {
        // 通信失败，重新初始化 OLED
        SSD1306_Init();
    }
}